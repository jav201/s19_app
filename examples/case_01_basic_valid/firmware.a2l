/begin PROJECT CASE01 "Synthetic project for S19Tool stress testing"
/begin HEADER VERSION "1.0" PROJECT_NO 1 /end HEADER
/begin MODULE BASIC "Synthetic ECU module"
/begin MOD_COMMON "" BYTE_ORDER MSB_FIRST ALIGNMENT_BYTE 1 ALIGNMENT_WORD 2 ALIGNMENT_LONG 4 ALIGNMENT_FLOAT32_IEEE 4 /end MOD_COMMON
/begin MOD_PAR "" EPK "S19TOOL_SYNTH" /end MOD_PAR
/begin RECORD_LAYOUT RL_U8 FNC_VALUES 1 UBYTE COLUMN_DIR DIRECT /end RECORD_LAYOUT
/begin RECORD_LAYOUT RL_U16 FNC_VALUES 1 UWORD COLUMN_DIR DIRECT /end RECORD_LAYOUT
/begin RECORD_LAYOUT RL_U32 FNC_VALUES 1 ULONG COLUMN_DIR DIRECT /end RECORD_LAYOUT
/begin COMPU_METHOD CM_IDENT "%6.2" IDENTICAL "%6.2" "" COEFFS 0 1 0 0 0 1 /end COMPU_METHOD
/begin CHARACTERISTIC CAL_BLOCK_A "CAL_BLOCK_A synthetic characteristic" VALUE 0x80000010 RL_U8 0 CM_IDENT 0 255 /end CHARACTERISTIC
/begin CHARACTERISTIC CAL_BLOCK_B "CAL_BLOCK_B synthetic characteristic" VALUE 0x80000040 RL_U8 0 CM_IDENT 0 255 /end CHARACTERISTIC
/begin MEASUREMENT MEAS_STATUS "MEAS_STATUS synthetic measurement" UBYTE CM_IDENT 0 0 0 255 ECU_ADDRESS 0x80000000 /end MEASUREMENT
/begin GROUP GRP_BASIC "GRP_BASIC group" /begin REF_CHARACTERISTIC CAL_BLOCK_A CAL_BLOCK_B /end REF_CHARACTERISTIC /end GROUP
/end MODULE
/end PROJECT
