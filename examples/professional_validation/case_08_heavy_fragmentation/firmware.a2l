/begin PROJECT CASE08 "Synthetic professional dataset for S19Tool"
/begin HEADER VERSION "1.0" PROJECT_NO 1 /end HEADER
/begin MODULE FRAG "Synthetic ECU module"
/begin MOD_COMMON "" BYTE_ORDER MSB_FIRST ALIGNMENT_BYTE 1 ALIGNMENT_WORD 2 ALIGNMENT_LONG 4 ALIGNMENT_FLOAT32_IEEE 4 /end MOD_COMMON
/begin MOD_PAR "" EPK "S19TOOL_PRO_SUITE" /end MOD_PAR
/begin RECORD_LAYOUT RL_U8 FNC_VALUES 1 UBYTE COLUMN_DIR DIRECT /end RECORD_LAYOUT
/begin RECORD_LAYOUT RL_U16 FNC_VALUES 1 UWORD COLUMN_DIR DIRECT /end RECORD_LAYOUT
/begin RECORD_LAYOUT RL_U32 FNC_VALUES 1 ULONG COLUMN_DIR DIRECT /end RECORD_LAYOUT
/begin COMPU_METHOD CM_IDENT "%6.2" IDENTICAL "%6.2" "" COEFFS 0 1 0 0 0 1 /end COMPU_METHOD
/begin CHARACTERISTIC FRAG_0000 "FRAG_0000 synthetic characteristic" VALUE 0x80300000 RL_U8 0 CM_IDENT 0 255 /end CHARACTERISTIC
/begin CHARACTERISTIC FRAG_0001 "FRAG_0001 synthetic characteristic" VALUE 0x80300040 RL_U8 0 CM_IDENT 0 255 /end CHARACTERISTIC
/begin CHARACTERISTIC FRAG_0002 "FRAG_0002 synthetic characteristic" VALUE 0x80300080 RL_U8 0 CM_IDENT 0 255 /end CHARACTERISTIC
/begin CHARACTERISTIC FRAG_0003 "FRAG_0003 synthetic characteristic" VALUE 0x803000C0 RL_U8 0 CM_IDENT 0 255 /end CHARACTERISTIC
/begin CHARACTERISTIC FRAG_0004 "FRAG_0004 synthetic characteristic" VALUE 0x80300100 RL_U8 0 CM_IDENT 0 255 /end CHARACTERISTIC
/begin CHARACTERISTIC FRAG_0005 "FRAG_0005 synthetic characteristic" VALUE 0x80300140 RL_U8 0 CM_IDENT 0 255 /end CHARACTERISTIC
/begin CHARACTERISTIC FRAG_0006 "FRAG_0006 synthetic characteristic" VALUE 0x80300180 RL_U8 0 CM_IDENT 0 255 /end CHARACTERISTIC
/begin CHARACTERISTIC FRAG_0007 "FRAG_0007 synthetic characteristic" VALUE 0x803001C0 RL_U8 0 CM_IDENT 0 255 /end CHARACTERISTIC
/begin CHARACTERISTIC FRAG_0008 "FRAG_0008 synthetic characteristic" VALUE 0x80300200 RL_U8 0 CM_IDENT 0 255 /end CHARACTERISTIC
/begin CHARACTERISTIC FRAG_0009 "FRAG_0009 synthetic characteristic" VALUE 0x80300240 RL_U8 0 CM_IDENT 0 255 /end CHARACTERISTIC
/begin CHARACTERISTIC FRAG_0010 "FRAG_0010 synthetic characteristic" VALUE 0x80300280 RL_U8 0 CM_IDENT 0 255 /end CHARACTERISTIC
/begin CHARACTERISTIC FRAG_0011 "FRAG_0011 synthetic characteristic" VALUE 0x803002C0 RL_U8 0 CM_IDENT 0 255 /end CHARACTERISTIC
/begin CHARACTERISTIC FRAG_0012 "FRAG_0012 synthetic characteristic" VALUE 0x80300300 RL_U8 0 CM_IDENT 0 255 /end CHARACTERISTIC
/begin CHARACTERISTIC FRAG_0013 "FRAG_0013 synthetic characteristic" VALUE 0x80300340 RL_U8 0 CM_IDENT 0 255 /end CHARACTERISTIC
/begin CHARACTERISTIC FRAG_0014 "FRAG_0014 synthetic characteristic" VALUE 0x80300380 RL_U8 0 CM_IDENT 0 255 /end CHARACTERISTIC
/begin CHARACTERISTIC FRAG_0015 "FRAG_0015 synthetic characteristic" VALUE 0x803003C0 RL_U8 0 CM_IDENT 0 255 /end CHARACTERISTIC
/begin CHARACTERISTIC FRAG_0016 "FRAG_0016 synthetic characteristic" VALUE 0x80300400 RL_U8 0 CM_IDENT 0 255 /end CHARACTERISTIC
/begin CHARACTERISTIC FRAG_0017 "FRAG_0017 synthetic characteristic" VALUE 0x80300440 RL_U8 0 CM_IDENT 0 255 /end CHARACTERISTIC
/begin CHARACTERISTIC FRAG_0018 "FRAG_0018 synthetic characteristic" VALUE 0x80300480 RL_U8 0 CM_IDENT 0 255 /end CHARACTERISTIC
/begin CHARACTERISTIC FRAG_0019 "FRAG_0019 synthetic characteristic" VALUE 0x803004C0 RL_U8 0 CM_IDENT 0 255 /end CHARACTERISTIC
/begin CHARACTERISTIC FRAG_0020 "FRAG_0020 synthetic characteristic" VALUE 0x80300500 RL_U8 0 CM_IDENT 0 255 /end CHARACTERISTIC
/begin CHARACTERISTIC FRAG_0021 "FRAG_0021 synthetic characteristic" VALUE 0x80300540 RL_U8 0 CM_IDENT 0 255 /end CHARACTERISTIC
/begin CHARACTERISTIC FRAG_0022 "FRAG_0022 synthetic characteristic" VALUE 0x80300580 RL_U8 0 CM_IDENT 0 255 /end CHARACTERISTIC
/begin CHARACTERISTIC FRAG_0023 "FRAG_0023 synthetic characteristic" VALUE 0x803005C0 RL_U8 0 CM_IDENT 0 255 /end CHARACTERISTIC
/begin CHARACTERISTIC FRAG_0024 "FRAG_0024 synthetic characteristic" VALUE 0x80300600 RL_U8 0 CM_IDENT 0 255 /end CHARACTERISTIC
/begin CHARACTERISTIC FRAG_0025 "FRAG_0025 synthetic characteristic" VALUE 0x80300640 RL_U8 0 CM_IDENT 0 255 /end CHARACTERISTIC
/begin CHARACTERISTIC FRAG_0026 "FRAG_0026 synthetic characteristic" VALUE 0x80300680 RL_U8 0 CM_IDENT 0 255 /end CHARACTERISTIC
/begin CHARACTERISTIC FRAG_0027 "FRAG_0027 synthetic characteristic" VALUE 0x803006C0 RL_U8 0 CM_IDENT 0 255 /end CHARACTERISTIC
/begin CHARACTERISTIC FRAG_0028 "FRAG_0028 synthetic characteristic" VALUE 0x80300700 RL_U8 0 CM_IDENT 0 255 /end CHARACTERISTIC
/begin CHARACTERISTIC FRAG_0029 "FRAG_0029 synthetic characteristic" VALUE 0x80300740 RL_U8 0 CM_IDENT 0 255 /end CHARACTERISTIC
/begin CHARACTERISTIC FRAG_0030 "FRAG_0030 synthetic characteristic" VALUE 0x80300780 RL_U8 0 CM_IDENT 0 255 /end CHARACTERISTIC
/begin CHARACTERISTIC FRAG_0031 "FRAG_0031 synthetic characteristic" VALUE 0x803007C0 RL_U8 0 CM_IDENT 0 255 /end CHARACTERISTIC
/begin CHARACTERISTIC FRAG_0032 "FRAG_0032 synthetic characteristic" VALUE 0x80300800 RL_U8 0 CM_IDENT 0 255 /end CHARACTERISTIC
/begin CHARACTERISTIC FRAG_0033 "FRAG_0033 synthetic characteristic" VALUE 0x80300840 RL_U8 0 CM_IDENT 0 255 /end CHARACTERISTIC
/begin CHARACTERISTIC FRAG_0034 "FRAG_0034 synthetic characteristic" VALUE 0x80300880 RL_U8 0 CM_IDENT 0 255 /end CHARACTERISTIC
/begin CHARACTERISTIC FRAG_0035 "FRAG_0035 synthetic characteristic" VALUE 0x803008C0 RL_U8 0 CM_IDENT 0 255 /end CHARACTERISTIC
/begin CHARACTERISTIC FRAG_0036 "FRAG_0036 synthetic characteristic" VALUE 0x80300900 RL_U8 0 CM_IDENT 0 255 /end CHARACTERISTIC
/begin CHARACTERISTIC FRAG_0037 "FRAG_0037 synthetic characteristic" VALUE 0x80300940 RL_U8 0 CM_IDENT 0 255 /end CHARACTERISTIC
/begin CHARACTERISTIC FRAG_0038 "FRAG_0038 synthetic characteristic" VALUE 0x80300980 RL_U8 0 CM_IDENT 0 255 /end CHARACTERISTIC
/begin CHARACTERISTIC FRAG_0039 "FRAG_0039 synthetic characteristic" VALUE 0x803009C0 RL_U8 0 CM_IDENT 0 255 /end CHARACTERISTIC
/begin CHARACTERISTIC FRAG_0040 "FRAG_0040 synthetic characteristic" VALUE 0x80300A00 RL_U8 0 CM_IDENT 0 255 /end CHARACTERISTIC
/begin CHARACTERISTIC FRAG_0041 "FRAG_0041 synthetic characteristic" VALUE 0x80300A40 RL_U8 0 CM_IDENT 0 255 /end CHARACTERISTIC
/begin CHARACTERISTIC FRAG_0042 "FRAG_0042 synthetic characteristic" VALUE 0x80300A80 RL_U8 0 CM_IDENT 0 255 /end CHARACTERISTIC
/begin CHARACTERISTIC FRAG_0043 "FRAG_0043 synthetic characteristic" VALUE 0x80300AC0 RL_U8 0 CM_IDENT 0 255 /end CHARACTERISTIC
/begin CHARACTERISTIC FRAG_0044 "FRAG_0044 synthetic characteristic" VALUE 0x80300B00 RL_U8 0 CM_IDENT 0 255 /end CHARACTERISTIC
/begin CHARACTERISTIC FRAG_0045 "FRAG_0045 synthetic characteristic" VALUE 0x80300B40 RL_U8 0 CM_IDENT 0 255 /end CHARACTERISTIC
/begin CHARACTERISTIC FRAG_0046 "FRAG_0046 synthetic characteristic" VALUE 0x80300B80 RL_U8 0 CM_IDENT 0 255 /end CHARACTERISTIC
/begin CHARACTERISTIC FRAG_0047 "FRAG_0047 synthetic characteristic" VALUE 0x80300BC0 RL_U8 0 CM_IDENT 0 255 /end CHARACTERISTIC
/begin CHARACTERISTIC FRAG_0048 "FRAG_0048 synthetic characteristic" VALUE 0x80300C00 RL_U8 0 CM_IDENT 0 255 /end CHARACTERISTIC
/begin CHARACTERISTIC FRAG_0049 "FRAG_0049 synthetic characteristic" VALUE 0x80300C40 RL_U8 0 CM_IDENT 0 255 /end CHARACTERISTIC
/begin CHARACTERISTIC FRAG_0050 "FRAG_0050 synthetic characteristic" VALUE 0x80300C80 RL_U8 0 CM_IDENT 0 255 /end CHARACTERISTIC
/begin CHARACTERISTIC FRAG_0051 "FRAG_0051 synthetic characteristic" VALUE 0x80300CC0 RL_U8 0 CM_IDENT 0 255 /end CHARACTERISTIC
/begin CHARACTERISTIC FRAG_0052 "FRAG_0052 synthetic characteristic" VALUE 0x80300D00 RL_U8 0 CM_IDENT 0 255 /end CHARACTERISTIC
/begin CHARACTERISTIC FRAG_0053 "FRAG_0053 synthetic characteristic" VALUE 0x80300D40 RL_U8 0 CM_IDENT 0 255 /end CHARACTERISTIC
/begin CHARACTERISTIC FRAG_0054 "FRAG_0054 synthetic characteristic" VALUE 0x80300D80 RL_U8 0 CM_IDENT 0 255 /end CHARACTERISTIC
/begin CHARACTERISTIC FRAG_0055 "FRAG_0055 synthetic characteristic" VALUE 0x80300DC0 RL_U8 0 CM_IDENT 0 255 /end CHARACTERISTIC
/begin CHARACTERISTIC FRAG_0056 "FRAG_0056 synthetic characteristic" VALUE 0x80300E00 RL_U8 0 CM_IDENT 0 255 /end CHARACTERISTIC
/begin CHARACTERISTIC FRAG_0057 "FRAG_0057 synthetic characteristic" VALUE 0x80300E40 RL_U8 0 CM_IDENT 0 255 /end CHARACTERISTIC
/begin CHARACTERISTIC FRAG_0058 "FRAG_0058 synthetic characteristic" VALUE 0x80300E80 RL_U8 0 CM_IDENT 0 255 /end CHARACTERISTIC
/begin CHARACTERISTIC FRAG_0059 "FRAG_0059 synthetic characteristic" VALUE 0x80300EC0 RL_U8 0 CM_IDENT 0 255 /end CHARACTERISTIC
/begin CHARACTERISTIC FRAG_0060 "FRAG_0060 synthetic characteristic" VALUE 0x80300F00 RL_U8 0 CM_IDENT 0 255 /end CHARACTERISTIC
/begin CHARACTERISTIC FRAG_0061 "FRAG_0061 synthetic characteristic" VALUE 0x80300F40 RL_U8 0 CM_IDENT 0 255 /end CHARACTERISTIC
/begin CHARACTERISTIC FRAG_0062 "FRAG_0062 synthetic characteristic" VALUE 0x80300F80 RL_U8 0 CM_IDENT 0 255 /end CHARACTERISTIC
/begin CHARACTERISTIC FRAG_0063 "FRAG_0063 synthetic characteristic" VALUE 0x80300FC0 RL_U8 0 CM_IDENT 0 255 /end CHARACTERISTIC
/begin CHARACTERISTIC FRAG_0064 "FRAG_0064 synthetic characteristic" VALUE 0x80301000 RL_U8 0 CM_IDENT 0 255 /end CHARACTERISTIC
/begin CHARACTERISTIC FRAG_0065 "FRAG_0065 synthetic characteristic" VALUE 0x80301040 RL_U8 0 CM_IDENT 0 255 /end CHARACTERISTIC
/begin CHARACTERISTIC FRAG_0066 "FRAG_0066 synthetic characteristic" VALUE 0x80301080 RL_U8 0 CM_IDENT 0 255 /end CHARACTERISTIC
/begin CHARACTERISTIC FRAG_0067 "FRAG_0067 synthetic characteristic" VALUE 0x803010C0 RL_U8 0 CM_IDENT 0 255 /end CHARACTERISTIC
/begin CHARACTERISTIC FRAG_0068 "FRAG_0068 synthetic characteristic" VALUE 0x80301100 RL_U8 0 CM_IDENT 0 255 /end CHARACTERISTIC
/begin CHARACTERISTIC FRAG_0069 "FRAG_0069 synthetic characteristic" VALUE 0x80301140 RL_U8 0 CM_IDENT 0 255 /end CHARACTERISTIC
/begin CHARACTERISTIC FRAG_0070 "FRAG_0070 synthetic characteristic" VALUE 0x80301180 RL_U8 0 CM_IDENT 0 255 /end CHARACTERISTIC
/begin CHARACTERISTIC FRAG_0071 "FRAG_0071 synthetic characteristic" VALUE 0x803011C0 RL_U8 0 CM_IDENT 0 255 /end CHARACTERISTIC
/begin CHARACTERISTIC FRAG_0072 "FRAG_0072 synthetic characteristic" VALUE 0x80301200 RL_U8 0 CM_IDENT 0 255 /end CHARACTERISTIC
/begin CHARACTERISTIC FRAG_0073 "FRAG_0073 synthetic characteristic" VALUE 0x80301240 RL_U8 0 CM_IDENT 0 255 /end CHARACTERISTIC
/begin CHARACTERISTIC FRAG_0074 "FRAG_0074 synthetic characteristic" VALUE 0x80301280 RL_U8 0 CM_IDENT 0 255 /end CHARACTERISTIC
/begin CHARACTERISTIC FRAG_0075 "FRAG_0075 synthetic characteristic" VALUE 0x803012C0 RL_U8 0 CM_IDENT 0 255 /end CHARACTERISTIC
/begin CHARACTERISTIC FRAG_0076 "FRAG_0076 synthetic characteristic" VALUE 0x80301300 RL_U8 0 CM_IDENT 0 255 /end CHARACTERISTIC
/begin CHARACTERISTIC FRAG_0077 "FRAG_0077 synthetic characteristic" VALUE 0x80301340 RL_U8 0 CM_IDENT 0 255 /end CHARACTERISTIC
/begin CHARACTERISTIC FRAG_0078 "FRAG_0078 synthetic characteristic" VALUE 0x80301380 RL_U8 0 CM_IDENT 0 255 /end CHARACTERISTIC
/begin CHARACTERISTIC FRAG_0079 "FRAG_0079 synthetic characteristic" VALUE 0x803013C0 RL_U8 0 CM_IDENT 0 255 /end CHARACTERISTIC
/begin CHARACTERISTIC FRAG_0080 "FRAG_0080 synthetic characteristic" VALUE 0x80301400 RL_U8 0 CM_IDENT 0 255 /end CHARACTERISTIC
/begin CHARACTERISTIC FRAG_0081 "FRAG_0081 synthetic characteristic" VALUE 0x80301440 RL_U8 0 CM_IDENT 0 255 /end CHARACTERISTIC
/begin CHARACTERISTIC FRAG_0082 "FRAG_0082 synthetic characteristic" VALUE 0x80301480 RL_U8 0 CM_IDENT 0 255 /end CHARACTERISTIC
/begin CHARACTERISTIC FRAG_0083 "FRAG_0083 synthetic characteristic" VALUE 0x803014C0 RL_U8 0 CM_IDENT 0 255 /end CHARACTERISTIC
/begin CHARACTERISTIC FRAG_0084 "FRAG_0084 synthetic characteristic" VALUE 0x80301500 RL_U8 0 CM_IDENT 0 255 /end CHARACTERISTIC
/begin CHARACTERISTIC FRAG_0085 "FRAG_0085 synthetic characteristic" VALUE 0x80301540 RL_U8 0 CM_IDENT 0 255 /end CHARACTERISTIC
/begin CHARACTERISTIC FRAG_0086 "FRAG_0086 synthetic characteristic" VALUE 0x80301580 RL_U8 0 CM_IDENT 0 255 /end CHARACTERISTIC
/begin CHARACTERISTIC FRAG_0087 "FRAG_0087 synthetic characteristic" VALUE 0x803015C0 RL_U8 0 CM_IDENT 0 255 /end CHARACTERISTIC
/begin CHARACTERISTIC FRAG_0088 "FRAG_0088 synthetic characteristic" VALUE 0x80301600 RL_U8 0 CM_IDENT 0 255 /end CHARACTERISTIC
/begin CHARACTERISTIC FRAG_0089 "FRAG_0089 synthetic characteristic" VALUE 0x80301640 RL_U8 0 CM_IDENT 0 255 /end CHARACTERISTIC
/begin CHARACTERISTIC FRAG_0090 "FRAG_0090 synthetic characteristic" VALUE 0x80301680 RL_U8 0 CM_IDENT 0 255 /end CHARACTERISTIC
/begin CHARACTERISTIC FRAG_0091 "FRAG_0091 synthetic characteristic" VALUE 0x803016C0 RL_U8 0 CM_IDENT 0 255 /end CHARACTERISTIC
/begin CHARACTERISTIC FRAG_0092 "FRAG_0092 synthetic characteristic" VALUE 0x80301700 RL_U8 0 CM_IDENT 0 255 /end CHARACTERISTIC
/begin CHARACTERISTIC FRAG_0093 "FRAG_0093 synthetic characteristic" VALUE 0x80301740 RL_U8 0 CM_IDENT 0 255 /end CHARACTERISTIC
/begin CHARACTERISTIC FRAG_0094 "FRAG_0094 synthetic characteristic" VALUE 0x80301780 RL_U8 0 CM_IDENT 0 255 /end CHARACTERISTIC
/begin CHARACTERISTIC FRAG_0095 "FRAG_0095 synthetic characteristic" VALUE 0x803017C0 RL_U8 0 CM_IDENT 0 255 /end CHARACTERISTIC
/begin CHARACTERISTIC FRAG_0096 "FRAG_0096 synthetic characteristic" VALUE 0x80301800 RL_U8 0 CM_IDENT 0 255 /end CHARACTERISTIC
/begin CHARACTERISTIC FRAG_0097 "FRAG_0097 synthetic characteristic" VALUE 0x80301840 RL_U8 0 CM_IDENT 0 255 /end CHARACTERISTIC
/begin CHARACTERISTIC FRAG_0098 "FRAG_0098 synthetic characteristic" VALUE 0x80301880 RL_U8 0 CM_IDENT 0 255 /end CHARACTERISTIC
/begin CHARACTERISTIC FRAG_0099 "FRAG_0099 synthetic characteristic" VALUE 0x803018C0 RL_U8 0 CM_IDENT 0 255 /end CHARACTERISTIC
/begin GROUP GRP_FRAG "GRP_FRAG synthetic group"
 /begin REF_CHARACTERISTIC FRAG_0000 FRAG_0001 FRAG_0002 FRAG_0003 FRAG_0004 FRAG_0005 FRAG_0006 FRAG_0007 FRAG_0008 FRAG_0009 FRAG_0010 FRAG_0011 FRAG_0012 FRAG_0013 FRAG_0014 FRAG_0015 FRAG_0016 FRAG_0017 FRAG_0018 FRAG_0019 FRAG_0020 FRAG_0021 FRAG_0022 FRAG_0023 FRAG_0024 FRAG_0025 FRAG_0026 FRAG_0027 FRAG_0028 FRAG_0029 FRAG_0030 FRAG_0031 FRAG_0032 FRAG_0033 FRAG_0034 FRAG_0035 FRAG_0036 FRAG_0037 FRAG_0038 FRAG_0039 FRAG_0040 FRAG_0041 FRAG_0042 FRAG_0043 FRAG_0044 FRAG_0045 FRAG_0046 FRAG_0047 FRAG_0048 FRAG_0049 FRAG_0050 FRAG_0051 FRAG_0052 FRAG_0053 FRAG_0054 FRAG_0055 FRAG_0056 FRAG_0057 FRAG_0058 FRAG_0059 FRAG_0060 FRAG_0061 FRAG_0062 FRAG_0063 FRAG_0064 FRAG_0065 FRAG_0066 FRAG_0067 FRAG_0068 FRAG_0069 FRAG_0070 FRAG_0071 FRAG_0072 FRAG_0073 FRAG_0074 FRAG_0075 FRAG_0076 FRAG_0077 FRAG_0078 FRAG_0079 FRAG_0080 FRAG_0081 FRAG_0082 FRAG_0083 FRAG_0084 FRAG_0085 FRAG_0086 FRAG_0087 FRAG_0088 FRAG_0089 FRAG_0090 FRAG_0091 FRAG_0092 FRAG_0093 FRAG_0094 FRAG_0095 FRAG_0096 FRAG_0097 FRAG_0098 FRAG_0099 /end REF_CHARACTERISTIC
/end GROUP
/end MODULE
/end PROJECT
