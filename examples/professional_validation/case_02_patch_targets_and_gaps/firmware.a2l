/begin PROJECT CASE02 "Synthetic professional dataset for S19Tool"
/begin HEADER VERSION "1.0" PROJECT_NO 1 /end HEADER
/begin MODULE PATCH "Synthetic ECU module"
/begin MOD_COMMON "" BYTE_ORDER MSB_FIRST ALIGNMENT_BYTE 1 ALIGNMENT_WORD 2 ALIGNMENT_LONG 4 ALIGNMENT_FLOAT32_IEEE 4 /end MOD_COMMON
/begin MOD_PAR "" EPK "S19TOOL_PRO_SUITE" /end MOD_PAR
/begin RECORD_LAYOUT RL_U8 FNC_VALUES 1 UBYTE COLUMN_DIR DIRECT /end RECORD_LAYOUT
/begin RECORD_LAYOUT RL_U16 FNC_VALUES 1 UWORD COLUMN_DIR DIRECT /end RECORD_LAYOUT
/begin RECORD_LAYOUT RL_U32 FNC_VALUES 1 ULONG COLUMN_DIR DIRECT /end RECORD_LAYOUT
/begin COMPU_METHOD CM_IDENT "%6.2" IDENTICAL "%6.2" "" COEFFS 0 1 0 0 0 1 /end COMPU_METHOD
/begin CHARACTERISTIC DATE_FIELD "DATE_FIELD synthetic characteristic" VALUE 0x80010005 RL_U8 0 CM_IDENT 0 255 /end CHARACTERISTIC
/begin MEASUREMENT MEAS_DATE_FIELD "MEAS_DATE_FIELD synthetic measurement" UBYTE CM_IDENT 0 0 0 255 ECU_ADDRESS 0x80010005 /end MEASUREMENT
/begin CHARACTERISTIC PATCH_BYTES "PATCH_BYTES synthetic characteristic" VALUE 0x80010080 RL_U8 0 CM_IDENT 0 255 /end CHARACTERISTIC
/begin MEASUREMENT MEAS_PATCH_BYTES "MEAS_PATCH_BYTES synthetic measurement" UBYTE CM_IDENT 0 0 0 255 ECU_ADDRESS 0x80010080 /end MEASUREMENT
/begin CHARACTERISTIC TABLE_1 "TABLE_1 synthetic characteristic" VALUE 0x80010140 RL_U8 0 CM_IDENT 0 255 /end CHARACTERISTIC
/begin MEASUREMENT MEAS_TABLE_1 "MEAS_TABLE_1 synthetic measurement" UBYTE CM_IDENT 0 0 0 255 ECU_ADDRESS 0x80010140 /end MEASUREMENT
/begin GROUP GRP_PATCH "GRP_PATCH synthetic group" /begin REF_CHARACTERISTIC DATE_FIELD PATCH_BYTES TABLE_1 /end REF_CHARACTERISTIC /end GROUP
/end MODULE
/end PROJECT
