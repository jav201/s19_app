/begin PROJECT CASE03 "Synthetic professional dataset for S19Tool"
/begin HEADER VERSION "1.0" PROJECT_NO 1 /end HEADER
/begin MODULE OVERLAP "Synthetic ECU module"
/begin MOD_COMMON "" BYTE_ORDER MSB_FIRST ALIGNMENT_BYTE 1 ALIGNMENT_WORD 2 ALIGNMENT_LONG 4 ALIGNMENT_FLOAT32_IEEE 4 /end MOD_COMMON
/begin MOD_PAR "" EPK "S19TOOL_PRO_SUITE" /end MOD_PAR
/begin RECORD_LAYOUT RL_U8 FNC_VALUES 1 UBYTE COLUMN_DIR DIRECT /end RECORD_LAYOUT
/begin RECORD_LAYOUT RL_U16 FNC_VALUES 1 UWORD COLUMN_DIR DIRECT /end RECORD_LAYOUT
/begin RECORD_LAYOUT RL_U32 FNC_VALUES 1 ULONG COLUMN_DIR DIRECT /end RECORD_LAYOUT
/begin COMPU_METHOD CM_IDENT "%6.2" IDENTICAL "%6.2" "" COEFFS 0 1 0 0 0 1 /end COMPU_METHOD
/begin CHARACTERISTIC OVER_A "OVER_A synthetic characteristic" VALUE 0x80020000 RL_U8 0 CM_IDENT 0 255 /end CHARACTERISTIC
/begin CHARACTERISTIC OVER_B "OVER_B synthetic characteristic" VALUE 0x80020008 RL_U8 0 CM_IDENT 0 255 /end CHARACTERISTIC
/begin CHARACTERISTIC SAFE_BLOCK "SAFE_BLOCK synthetic characteristic" VALUE 0x80020030 RL_U8 0 CM_IDENT 0 255 /end CHARACTERISTIC
/begin GROUP GRP_OVERLAP "GRP_OVERLAP synthetic group" /begin REF_CHARACTERISTIC OVER_A OVER_B SAFE_BLOCK /end REF_CHARACTERISTIC /end GROUP
/end MODULE
/end PROJECT
