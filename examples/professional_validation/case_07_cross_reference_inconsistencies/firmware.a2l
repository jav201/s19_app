/begin PROJECT CASE07 "Synthetic professional dataset for S19Tool"
/begin HEADER VERSION "1.0" PROJECT_NO 1 /end HEADER
/begin MODULE XREF "Synthetic ECU module"
/begin MOD_COMMON "" BYTE_ORDER MSB_FIRST ALIGNMENT_BYTE 1 ALIGNMENT_WORD 2 ALIGNMENT_LONG 4 ALIGNMENT_FLOAT32_IEEE 4 /end MOD_COMMON
/begin MOD_PAR "" EPK "S19TOOL_PRO_SUITE" /end MOD_PAR
/begin RECORD_LAYOUT RL_U8 FNC_VALUES 1 UBYTE COLUMN_DIR DIRECT /end RECORD_LAYOUT
/begin RECORD_LAYOUT RL_U16 FNC_VALUES 1 UWORD COLUMN_DIR DIRECT /end RECORD_LAYOUT
/begin RECORD_LAYOUT RL_U32 FNC_VALUES 1 ULONG COLUMN_DIR DIRECT /end RECORD_LAYOUT
/begin COMPU_METHOD CM_IDENT "%6.2" IDENTICAL "%6.2" "" COEFFS 0 1 0 0 0 1 /end COMPU_METHOD
/begin CHARACTERISTIC VALID_BLOCK "VALID_BLOCK synthetic characteristic" VALUE 0x80200000 RL_U8 0 CM_IDENT 0 255 /end CHARACTERISTIC
/begin CHARACTERISTIC VALID_TARGET "VALID_TARGET synthetic characteristic" VALUE 0x80200100 RL_U8 0 CM_IDENT 0 255 /end CHARACTERISTIC
/begin CHARACTERISTIC A2L_ONLY_SYMBOL "A2L_ONLY_SYMBOL synthetic characteristic" VALUE 0x8020E000 RL_U8 0 CM_IDENT 0 255 /end CHARACTERISTIC
/begin CHARACTERISTIC ALIAS_1 "ALIAS_1 synthetic characteristic" VALUE 0x80200010 RL_U8 0 CM_IDENT 0 255 /end CHARACTERISTIC
/begin GROUP GRP_XREF "GRP_XREF synthetic group" /begin REF_CHARACTERISTIC VALID_BLOCK VALID_TARGET A2L_ONLY_SYMBOL ALIAS_1 /end REF_CHARACTERISTIC /end GROUP
/end MODULE
/end PROJECT
