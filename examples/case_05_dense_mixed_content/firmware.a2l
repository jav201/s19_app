/begin PROJECT CASE05 "Synthetic project for S19Tool stress testing"
/begin HEADER VERSION "1.0" PROJECT_NO 1 /end HEADER
/begin MODULE MIXED "Synthetic ECU module"
/begin MOD_COMMON "" BYTE_ORDER MSB_FIRST ALIGNMENT_BYTE 1 ALIGNMENT_WORD 2 ALIGNMENT_LONG 4 ALIGNMENT_FLOAT32_IEEE 4 /end MOD_COMMON
/begin MOD_PAR "" EPK "S19TOOL_SYNTH" /end MOD_PAR
/begin RECORD_LAYOUT RL_U8 FNC_VALUES 1 UBYTE COLUMN_DIR DIRECT /end RECORD_LAYOUT
/begin RECORD_LAYOUT RL_U16 FNC_VALUES 1 UWORD COLUMN_DIR DIRECT /end RECORD_LAYOUT
/begin RECORD_LAYOUT RL_U32 FNC_VALUES 1 ULONG COLUMN_DIR DIRECT /end RECORD_LAYOUT
/begin COMPU_METHOD CM_IDENT "%6.2" IDENTICAL "%6.2" "" COEFFS 0 1 0 0 0 1 /end COMPU_METHOD
/begin CHARACTERISTIC VECTOR_LIKE_HEADER_01 "VECTOR_LIKE_HEADER_01 synthetic characteristic" VALUE 0x80040000 RL_U8 0 CM_IDENT 0 255 /end CHARACTERISTIC
/begin CHARACTERISTIC DATE_PLACEHOLDER "DATE_PLACEHOLDER synthetic characteristic" VALUE 0x80040056 RL_U8 0 CM_IDENT 0 255 /end CHARACTERISTIC
/begin CHARACTERISTIC RAW_PATTERN "RAW_PATTERN synthetic characteristic" VALUE 0x80040070 RL_U8 0 CM_IDENT 0 255 /end CHARACTERISTIC
/begin CHARACTERISTIC ASCII_TRAILER "ASCII_TRAILER synthetic characteristic" VALUE 0x80040080 RL_U8 0 CM_IDENT 0 255 /end CHARACTERISTIC
/begin GROUP GRP_MIXED "GRP_MIXED group"
 /begin REF_CHARACTERISTIC VECTOR_LIKE_HEADER_01 DATE_PLACEHOLDER RAW_PATTERN ASCII_TRAILER /end REF_CHARACTERISTIC
/end GROUP
/end MODULE
/end PROJECT
