ASAP2_VERSION 1 71
/begin PROJECT StressProject
/begin MODULE StressModule
/begin MOD_COMMON StressMod BYTE_ORDER MSB_LAST ALIGNMENT_BYTE 1 /end MOD_COMMON
/begin MEMORY_SEGMENT main FLASH INTERN_FLASH EXTERN 0x08000000 0x00000400 /end MEMORY_SEGMENT
/begin MEASUREMENT MEAS_000000 ECU_ADDRESS 0x08001400 DATA_SIZE 2 LOWER_LIMIT 0 UPPER_LIMIT 65535 UNIT unit READ_ONLY /end MEASUREMENT
/begin MEASUREMENT MEAS_000001 ECU_ADDRESS 0x08001404 DATA_SIZE 2 LOWER_LIMIT 0 UPPER_LIMIT 65535 UNIT unit READ_ONLY /end MEASUREMENT
/begin MEASUREMENT MEAS_000002 ECU_ADDRESS 0x08000008 DATA_SIZE 2 LOWER_LIMIT 0 UPPER_LIMIT 65535 UNIT unit READ_ONLY /end MEASUREMENT
/begin MEASUREMENT MEAS_000003 ECU_ADDRESS 0x0800000C DATA_SIZE 2 LOWER_LIMIT 0 UPPER_LIMIT 65535 UNIT unit READ_ONLY /end MEASUREMENT
/begin MEASUREMENT MEAS_000004 ECU_ADDRESS 0x08000010 DATA_SIZE 2 LOWER_LIMIT 0 UPPER_LIMIT 65535 UNIT unit READ_ONLY /end MEASUREMENT
/begin MEASUREMENT MEAS_000005 ECU_ADDRESS 0x08000014 DATA_SIZE 2 LOWER_LIMIT 0 UPPER_LIMIT 65535 UNIT unit READ_ONLY /end MEASUREMENT
/begin MEASUREMENT MEAS_000006 ECU_ADDRESS 0x08001418 DATA_SIZE 2 LOWER_LIMIT 0 UPPER_LIMIT 65535 UNIT unit READ_ONLY /end MEASUREMENT
/begin MEASUREMENT MEAS_000007 ECU_ADDRESS 0x0800001C DATA_SIZE 2 LOWER_LIMIT 0 UPPER_LIMIT 65535 UNIT unit READ_ONLY /end MEASUREMENT
/begin MEASUREMENT MEAS_000008 ECU_ADDRESS 0x08000020 DATA_SIZE 2 LOWER_LIMIT 0 UPPER_LIMIT 65535 UNIT unit READ_ONLY /end MEASUREMENT
/begin MEASUREMENT MEAS_000009 ECU_ADDRESS 0x08000024 DATA_SIZE 2 LOWER_LIMIT 0 UPPER_LIMIT 65535 UNIT unit READ_ONLY /end MEASUREMENT
/begin CHARACTERISTIC CHAR_000000 ECU_ADDRESS 0x08011400 LENGTH 4 BYTE_ORDER LITTLE_ENDIAN FUNCTION FG CALIBRATABLE /end CHARACTERISTIC
/begin CHARACTERISTIC CHAR_000001 ECU_ADDRESS 0x08000006 LENGTH 4 BYTE_ORDER LITTLE_ENDIAN FUNCTION FG CALIBRATABLE /end CHARACTERISTIC
/end MODULE
/end PROJECT
