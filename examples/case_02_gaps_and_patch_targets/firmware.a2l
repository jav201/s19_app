/begin PROJECT CASE02 "Synthetic project for S19Tool stress testing"
/begin HEADER VERSION "1.0" PROJECT_NO 1 /end HEADER
/begin MODULE GAPS "Synthetic ECU module"
/begin MOD_COMMON "" BYTE_ORDER MSB_FIRST ALIGNMENT_BYTE 1 ALIGNMENT_WORD 2 ALIGNMENT_LONG 4 ALIGNMENT_FLOAT32_IEEE 4 /end MOD_COMMON
/begin MOD_PAR "" EPK "S19TOOL_SYNTH" /end MOD_PAR
/begin RECORD_LAYOUT RL_U8 FNC_VALUES 1 UBYTE COLUMN_DIR DIRECT /end RECORD_LAYOUT
/begin RECORD_LAYOUT RL_U16 FNC_VALUES 1 UWORD COLUMN_DIR DIRECT /end RECORD_LAYOUT
/begin RECORD_LAYOUT RL_U32 FNC_VALUES 1 ULONG COLUMN_DIR DIRECT /end RECORD_LAYOUT
/begin COMPU_METHOD CM_IDENT "%6.2" IDENTICAL "%6.2" "" COEFFS 0 1 0 0 0 1 /end COMPU_METHOD
/begin CHARACTERISTIC DATE_FIELD "DATE_FIELD synthetic characteristic" VALUE 0x80010000 RL_U8 0 CM_IDENT 0 255 /end CHARACTERISTIC
/begin CHARACTERISTIC PATCH_BYTES "PATCH_BYTES synthetic characteristic" VALUE 0x80010080 RL_U8 0 CM_IDENT 0 255 /end CHARACTERISTIC
/begin CHARACTERISTIC TABLE_1 "TABLE_1 synthetic characteristic" VALUE 0x80010120 RL_U8 0 CM_IDENT 0 255 /end CHARACTERISTIC
/begin GROUP GRP_PATCHABLE "GRP_PATCHABLE group" /begin REF_CHARACTERISTIC DATE_FIELD PATCH_BYTES TABLE_1 /end REF_CHARACTERISTIC /end GROUP
/end MODULE
/end PROJECT
